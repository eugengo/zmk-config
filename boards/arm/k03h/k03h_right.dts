#include "k03h.dtsi"
#include "k03h_right-pinctrl.dtsi"

&default_transform {
    col-offset = <6>;
};

&kscan {
    col-gpios = <&gpio0 15 GPIO_ACTIVE_LOW>,
                <&gpio0 16 GPIO_ACTIVE_LOW>,
                <&gpio0 17 GPIO_ACTIVE_LOW>,
                <&gpio0 18 GPIO_ACTIVE_LOW>,
                <&gpio0 19 GPIO_ACTIVE_LOW>,
                <&gpio0 20 GPIO_ACTIVE_LOW>;
};

