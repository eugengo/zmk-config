## boards/arm/k03h/Kconfig.board
```kconfig
config BOARD_K03H_LEFT
    bool "k03h left"
    depends on SOC_RP2040
    select SOC_RP2040
```

## boards/shields/k03h/Kconfig.defconfig
```kconfig
config SHIELD_K03H_LEFT
    bool "k03h left"
    default y

config SHIELD_K03H_RIGHT
    bool "k03h right"
    default y
```
