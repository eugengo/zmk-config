// This file was generated from a template. Edit it to match your keyboard.
// See https://zmk.dev/docs/development/hardware-integration/new-shield for more
// instructions.

#include "k03h.dtsi"
#include "k03h_right-pinctrl.dtsi"

&default_transform {
    // Set this to the number of columns on the left side.
    col-offset = <6>;
};

&kscan {
    // Replace these comments with the GPIO pins in the matrix for the right side.
    // See https://zmk.dev/docs/development/hardware-integration/new-shield#shield-overlays
    col-gpios = <&gpio0 15 GPIO_ACTIVE_LOW>,
                <&gpio0 16 GPIO_ACTIVE_LOW>,
                <&gpio0 17 GPIO_ACTIVE_LOW>,
                <&gpio0 18 GPIO_ACTIVE_LOW>,
                <&gpio0 19 GPIO_ACTIVE_LOW>,
                <&gpio0 20 GPIO_ACTIVE_LOW>;
};
