/ {
    kscan: kscan {
        compatible = "zmk,kscan-gpio-matrix";
        diode-direction = "col2row";

        row-gpios = <&gpio0 4 (GPIO_ACTIVE_HIGH)>,
                    <&gpio0 5 (GPIO_ACTIVE_HIGH)>,
                    <&gpio0 6 (GPIO_ACTIVE_HIGH)>,
                    <&gpio0 7 (GPIO_ACTIVE_HIGH)>,
                    <&gpio0 8 (GPIO_ACTIVE_HIGH)>;

        col-gpios = <&gpio0 9 (GPIO_ACTIVE_HIGH)>,
                    <&gpio0 10 (GPIO_ACTIVE_HIGH)>,
                    <&gpio0 11 (GPIO_ACTIVE_HIGH)>,
                    <&gpio0 12 (GPIO_ACTIVE_HIGH)>,
                    <&gpio0 13 (GPIO_ACTIVE_HIGH)>,
                    <&gpio0 14 (GPIO_ACTIVE_HIGH)>;
    };

    mtx_transform: keymap_transform {
        compatible = "zmk,matrix-transform";
        rows = <5>;
        cols = <6>;
        map = <
            0  1  2  3  4  5
            6  7  8  9  10 11
            12 13 14 15 16 17
            18 19 20 21 22 23
            24 25 26 27 28 29
        >;
    };

    chosen {
        zmk,kscan = &kscan;
        zmk,matrix-transform = &mtx_transform;
    };
};

