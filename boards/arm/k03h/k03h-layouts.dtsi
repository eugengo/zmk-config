#include <physical_layouts.dtsi>

/ {
    k03h_physical_layout: k03h_physical_layout {
        compatible = "zmk,physical-layout";
        display-name = "K:03 Default Layout";
        transform = <&default_transform>;
        kscan = <&kscan>;
    };
};

