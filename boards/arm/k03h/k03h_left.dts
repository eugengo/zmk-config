#include "k03h.dtsi"
#include "k03h_left-pinctrl.dtsi"

&kscan {
    col-gpios = <&gpio0 9 GPIO_ACTIVE_LOW>,
                <&gpio0 10 GPIO_ACTIVE_LOW>,
                <&gpio0 11 GPIO_ACTIVE_LOW>,
                <&gpio0 12 GPIO_ACTIVE_LOW>,
                <&gpio0 13 GPIO_ACTIVE_LOW>,
                <&gpio0 14 GPIO_ACTIVE_LOW>;
    hand-detect-gpios = <&gpio0 29 GPIO_ACTIVE_LOW>;
};

