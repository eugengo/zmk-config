//#include "k03h.dtsi"
//#include "k03h_left-pinctrl.dtsi"


/ {
    chosen {
        zmk,kscan = &kscan0;
    };

    kscan0: kscan {
        compatible = "zmk,kscan-gpio-matrix";
        diode-direction = "col2row";

        rows = <5>;
        cols = <6>;

        row-gpios = <&gpio0 4 (GPIO_ACTIVE_HIGH)>,  /* GP4 */
                    <&gpio0 5 (GPIO_ACTIVE_HIGH)>,  /* GP5 */
                    <&gpio0 6 (GPIO_ACTIVE_HIGH)>,  /* GP6 */
                    <&gpio0 7 (GPIO_ACTIVE_HIGH)>,  /* GP7 */
                    <&gpio0 8 (GPIO_ACTIVE_HIGH)>;  /* GP8 */

        col-gpios = <&gpio0 9 (GPIO_ACTIVE_HIGH)>,   /* GP9  */
                    <&gpio0 10 (GPIO_ACTIVE_HIGH)>,  /* GP10 */
                    <&gpio0 11 (GPIO_ACTIVE_HIGH)>,  /* GP11 */
                    <&gpio0 12 (GPIO_ACTIVE_HIGH)>,  /* GP12 */
                    <&gpio0 13 (GPIO_ACTIVE_HIGH)>,  /* GP13 */
                    <&gpio0 14 (GPIO_ACTIVE_HIGH)>;  /* GP14 */
    };
};

